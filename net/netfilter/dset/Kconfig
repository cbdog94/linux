## net/netfilter/dset/Kconfig
```kconfig
menuconfig DOMAIN_SET
	tristate "DOMAIN set support"
	depends on INET && NETFILTER
	select NETFILTER_NETLINK
	help
	  This option adds DOMAIN set support to the kernel.
	  In order to define and use the sets, you need the userspace utility
	  dset(8). You can use the sets in netfilter via the "set" match
	  and "SET" target.

	  To compile it as a module, choose M here.  If unsure, say N.

if DOMAIN_SET

config DOMAIN_SET_MAX
	int "Maximum number of DOMAIN sets"
	default 256
	range 2 65534
	depends on DOMAIN_SET
	help
	  You can define here default value of the maximum number 
	  of DOMAIN sets for the kernel.

	  The value can be overriden by the 'max_sets' module
	  parameter of the 'domain_set' module.

config DOMAIN_SET_HASH_DOMAIN
	tristate "hash:domain set support"
	depends on DOMAIN_SET
	help
	  This option adds the hash:domain set type support, by which one
	  can store arbitrary domain in a set.

	  To compile it as a module, choose M here.  If unsure, say N.

endif # DOMAIN_SET
```
